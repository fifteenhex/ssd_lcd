## project/configs/Kconfigs/sdk/verify/application/Kconfig
```kconfig
menu "Application Compile Config"
comment "Application Compile Config"

config VERIFY_UI_DEMO
    bool

config verify_ui_demo
    string
    default enable if VERIFY_UI_DEMO

config VERIFY_ZK_BOOTUP
    bool "zk_bootup"
    default n
    select VERIFY_UI_DEMO
    help
        whether to compile or not

config verify_zk_bootup
    string
    default enable if VERIFY_ZK_BOOTUP
    default disable

config VERIFY_ZK_MINI
    bool "zk_mini"
    default n
    select VERIFY_UI_DEMO
    help
        whether to compile or not

config verify_zk_mini
    string
    default enable if VERIFY_ZK_MINI
    default disable

config VERIFY_ZK_FULL
    bool "zk_full"
    default n
    select VERIFY_UI_DEMO
    help
        whether to compile or not

config verify_zk_full
    string
    default enable if VERIFY_ZK_FULL
    default disable

config VERIFY_ZK_MINI_NOSENSOR
    bool "zk_mini_nosensor"
    default n
    select VERIFY_UI_DEMO
    help
        whether to compile or not

config verify_zk_mini_nosensor
    string
    default enable if VERIFY_ZK_MINI_NOSENSOR
    default disable

config VERIFY_ZK_MINI_FASTBOOT
    bool "zk_mini_fastboot"
    default n
    select VERIFY_UI_DEMO
    help
        whether to compile or not

config verify_zk_mini_fastboot
    string
    default enable if VERIFY_ZK_MINI_FASTBOOT
    default disable

config VERIFY_ZK_FULL_FASTBOOT
    bool "zk_full_fastboot"
    default n
    select VERIFY_UI_DEMO
    help
        whether to compile or not

config verify_zk_full_fastboot
    string
    default enable if VERIFY_ZK_FULL_FASTBOOT
    default disable

config VERIFY_ZK_MINI_NOSENSOR_FASTBOOT
    bool "zk_mini_nosensor_fastboot"
    default n
    select VERIFY_UI_DEMO
    help
        whether to compile or not

config verify_zk_mini_nosensor_fastboot
    string
    default enable if VERIFY_ZK_MINI_NOSENSOR_FASTBOOT
    default disable

config VERIFY_QFN68_SENSOR_PANEL
    bool "qfn68 Sensor to Panel"
    default n
    select VERIFY_UI_DEMO
    help
        whether to compile or not

config verify_qfn68_sensor_panel
    string
    default enable if VERIFY_QFN68_SENSOR_PANEL
    default disable

config VERIFY_BARCODE
    bool "bar code scanning gun"
    default n
    select VERIFY_UI_DEMO
    help
        whether to compile or not

config verify_barcode
    string
    default enable if VERIFY_BARCODE
    default disable

config VERIFY_DISP_PIC_FASTBOOT
    bool "disp_pic_fastboot"
    default n
    select VERIFY_UI_DEMO
    help
        whether to compile or not

config verify_disp_pic_fastboot
    string
    default enable if VERIFY_DISP_PIC_FASTBOOT
    default disable

config VERIFY_USBCAMERA_FASTBOOT
    bool "usbcamera_fastboot"
    default n
    select VERIFY_UI_DEMO
    help
        whether to compile or not

config verify_usbcamera_fastboot
    string
    default enable if VERIFY_USBCAMERA_FASTBOOT
    default disable

config VERIFY_USBCAMERA
    bool "usbcamera"
    default n
    select VERIFY_UI_DEMO
    help
        whether to compile or not

config verify_usbcamera
    string
    default enable if VERIFY_USBCAMERA
    default disable

config VERIFY_USBCAM_FASTBOOT
    bool "usbcam_fastboot"
    default n
    select VERIFY_UI_DEMO
    help
        whether to compile or not

config verify_usbcam_fastboot
    string
    default enable if VERIFY_USBCAM_FASTBOOT
    default disable


config VERIFY_BARCODEYUYAN
    bool "bar code Yuyan scanning gun"
    default n
    select VERIFY_UI_DEMO
    help
        whether to compile or not

config verify_barcodeYuyan
    string
    default enable if VERIFY_BARCODEYUYAN
    default disable
	
config VERIFY_JPEG2DISP
    bool "jpeg2disp"
    default n
    select VERIFY_UI_DEMO
    help
        whether to compile or not

config verify_jpeg2disp
    string
    default enable if VERIFY_JPEG2DISP
    default disable
	
endmenu
```

## project/configs/Kconfigs/sdk/verify/feature/Kconfig
```kconfig
menu "Feature Compile Config"
comment "Feature Compile Config"

config VERIFY_AI
    bool "ai"
    default n
    help
        whether to compile or not

config verify_ai
    string
    default enable if VERIFY_AI
    default disable if !VERIFY_AI


config VERIFY_AO
    bool "ao"
    default n
    help
        whether to compile or not

config verify_ao
    string
    default enable if VERIFY_AO
    default disable if !VERIFY_AO


config VERIFY_CIPHER
    bool "cipher"
    default n
    help
        whether to compile or not

config verify_cipher
    string
    default enable if VERIFY_CIPHER
    default disable if !VERIFY_CIPHER


config VERIFY_DISP
    bool "disp"
    default n
    help
        whether to compile or not

config verify_disp
    string
    default enable if VERIFY_DISP
    default disable if !VERIFY_DISP


config VERIFY_DIVP
    bool "divp"
    default n
    help
        whether to compile or not

config verify_divp
    string
    default enable if VERIFY_DIVP
    default disable if !VERIFY_DIVP


config VERIFY_DLA
    bool "dla"
    default n
    help
        whether to compile or not

config verify_dla
    string
    default enable if VERIFY_DLA
    default disable if !VERIFY_DLA


config VERIFY_FB
    bool "fb"
    default n
    help
        whether to compile or not

config verify_fb
    string
    default enable if VERIFY_FB
    default disable if !VERIFY_FB


config VERIFY_GFX
    bool "gfx"
    default n
    help
        whether to compile or not

config verify_gfx
    string
    default enable if VERIFY_GFX
    default disable if !VERIFY_GFX


config VERIFY_HDMI
    bool "hdmi"
    default n
    help
        whether to compile or not

config verify_hdmi
    string
    default enable if VERIFY_HDMI
    default disable if !VERIFY_HDMI


config VERIFY_IPU
    bool "ipu"
    default n
    help
        whether to compile or not

config verify_ipu
    string
    default enable if VERIFY_IPU
    default disable if !VERIFY_IPU


config VERIFY_JPD
    bool "jpd"
    default n
    help
        whether to compile or not

config verify_jpd
    string
    default enable if VERIFY_JPD
    default disable if !VERIFY_JPD


config VERIFY_SHADOW
    bool "shadow"
    default n
    help
        whether to compile or not

config verify_shadow
    string
    default enable if VERIFY_SHADOW
    default disable if !VERIFY_SHADOW


config VERIFY_SYS
    bool "sys"
    default n
    help
        whether to compile or not

config verify_sys
    string
    default enable if VERIFY_SYS
    default disable if !VERIFY_SYS

config VERIFY_UVC_UAC
    bool "uvc_uac"
    default n
    help
        whether to compile or not

config verify_uvc_uac
    string
    default enable if VERIFY_UVC_UAC
    default disable if !VERIFY_UVC_UAC

config VERIFY_UAC
    bool "uac"
    default n
    help
        whether to compile or not

config verify_uac
    string
    default enable if VERIFY_UAC
    default disable if !VERIFY_UAC


config VERIFY_VDEC
    bool "vdec"
    default n
    help
        whether to compile or not

config verify_vdec
    string
    default enable if VERIFY_VDEC
    default disable if !VERIFY_VDEC


config VERIFY_VDISP
    bool "vdisp"
    default n
    help
        whether to compile or not

config verify_vdisp
    string
    default enable if VERIFY_VDISP
    default disable if !VERIFY_VDISP


config VERIFY_VENC
    bool "venc"
    default n
    help
        whether to compile or not

config verify_venc
    string
    default enable if VERIFY_VENC
    default disable if !VERIFY_VENC


config VERIFY_VIF
    bool "vif"
    default n
    help
        whether to compile or not

config verify_vif
    string
    default enable if VERIFY_VIF
    default disable if !VERIFY_VIF


config VERIFY_VPE
    bool "vpe"
    default n
    help
        whether to compile or not

config verify_vpe
    string
    default enable if VERIFY_VPE
    default disable if !VERIFY_VPE


config VERIFY_WARP
    bool "warp"
    default n
    help
        whether to compile or not

config verify_warp
    string
    default enable if VERIFY_WARP
    default disable if !VERIFY_WARP


config VERIFY_WLAN
    bool "wlan"
    default n
    help
        whether to compile or not

config verify_wlan
    string
    default enable if VERIFY_WLAN
    default disable if !VERIFY_WLAN


config VERIFY_MDB
    bool "mdb"
    default n
    help
        whether to compile or not

config verify_mdb
    string
    default enable if VERIFY_MDB
    default disable if !VERIFY_MDB

endmenu
```

## project/configs/Kconfigs/sdk/verify/mi_demo/Kconfig
```kconfig
config VERIFY_MI_DEMO
    bool "mi_demo"
    default n
    help
        whether to compile or not

config verify_mi_demo
    string
    default enable if VERIFY_MI_DEMO
    default disable if !VERIFY_MI_DEMO
```

## project/configs/Kconfigs/sdk/verify/mixer/Kconfig
```kconfig
config VERIFY_MIXER
    bool "mixer"
    default n
    help
        whether to compile or not

config verify_mixer
    string
    default enable if VERIFY_MIXER
    default disable if !VERIFY_MIXER
```

## project/configs/Kconfigs/sdk/verify/py_ipu/Kconfig
```kconfig
config VERIFY_PY_IPU
    bool "py_ipu"
    default n
    help
        whether to compile or not

config verify_py_ipu
    string
    default enable if VERIFY_PY_IPU
    default disable if !VERIFY_PY_IPU
```

## project/configs/Kconfigs/sensor/Kconfig
```kconfig
menu "Sensor"
config IQ0
    string "IQ0"
    default ""

config IQ1
    string "IQ1"
    default ""

config IQ2
    string "IQ2"
    default ""

config IQ3
    string "IQ3"
    default ""

config IQ_API0
    string "IQ_API0"
    default ""

config IQ_API1
    string "IQ_API1"
    default ""

config SENSOR_LIST
    string "Sensor List"
    default ""

config SENSOR0
    string "Sensor0"
    default ""

config SENSOR0_OPT
    string "Sensor0 Opt"
    default ""

config SENSOR1
    string "Sensor1"
    default ""

config SENSOR1_OPT
    string "Sensor1 Opt"
    default ""

config SENSOR2
    string "Sensor2"
    default ""

config SENSOR2_OPT
    string "Sensor2 Opt"
    default ""

endmenu
```

## project/configs/Kconfigs/sigma_wifi/Kconfig
```kconfig
choice
    prompt "sigma_wifi"
    default NO_WIFI

    config NO_WIFI
        bool "no_wifi"

    config SSW101B_WIFI_USB
        bool "ssw101b_wifi_usb"

    config SSW102B_WIFI_SDIO
        bool "ssw102b_wifi_sdio"
endchoice

config SIGMA_WIFI
    string
    default no_wifi if NO_WIFI
    default ssw101b_wifi_usb if SSW101B_WIFI_USB
    default ssw102b_wifi_sdio if SSW102B_WIFI_SDIO
```
