## boot/arch/arm/cpu/armv7/pioneer3/Kconfig
```kconfig
if PIONEER3

config SYS_CONFIG_NAME
    default "pioneer3"
    ---help---
    To load the "include/configs/pioneer3.h"


config SYS_SOC
    default "pioneer3"
    ---help---
    To generate correct  "arch/arm/include/asm/arch"

config SYS_GENERIC_BOARD
    bool
    default y

config VERSION_FPGA
    bool "FPGA version"
    default n

config SS_BOOTING_PERF
    bool "booting time"
    default y

config SSTAR_SPL_EARLY_BSS
    bool "clear bss section first before run board_f"
    default n

config SS_BOARD_RAMSIZE_MB_16
	bool "Board with 16 MB DDR"
config SS_BOARD_RAMSIZE_MB_64
	bool "Board with 64 MB DDR"

choice
	prompt "RAM chip size"
	default SS_RAMSIZE_MB_16 if SS_BOARD_RAMSIZE_MB_16
	default SS_RAMSIZE_MB_64 if SS_BOARD_RAMSIZE_MB_64
	help
	  Select the size of the RAM.

config SS_RAMSIZE_MB_16
	bool "16 MB"
	help
	  Choose this option if you have a 16 MB RAM chip.

config SS_RAMSIZE_MB_64
	bool "64 MB"
	help
	  Choose this option if you have a 64 MB RAM chip.

endchoice

config SS_RAM_SIZE
	hex
	default 0x01000000 if SS_RAMSIZE_MB_16
	default 0x04000000 if SS_RAMSIZE_MB_64

config SS_LOAD_ADDR
	hex
	default 0x20D00000 if SS_RAMSIZE_MB_16
	default 0x23D00000 if SS_RAMSIZE_MB_64

config SS_RUN_ADDR
	hex
	default 0x20E00000 if SS_RAMSIZE_MB_16
	default 0x23E00000 if SS_RAMSIZE_MB_64

config SYS_TEXT_BASE
	hex
	default 0x20E00000 if SS_RAMSIZE_MB_16
	default 0x23E00000 if SS_RAMSIZE_MB_64

endif
```

## boot/fs/firmwarefs/Kconfig
```kconfig
config FS_FIRMWAREFS
	bool "Support Firmware FileSystem"

config FIRMWAREFS_ON_MMC
	bool "Use firmwarefs on emmc/sdcard device"
	depends on FS_FIRMWAREFS
```

## project/Kconfig
```kconfig
#
# For a description of the syntax of this configuration file,
# see kernel/Documentation/kbuild/kconfig-language.txt.
mainmenu "Alkaid Configuration"

source configs/Kconfigs/chip/Kconfig

source configs/Kconfigs/product/Kconfig

source configs/Kconfigs/sigma_wifi/Kconfig

source configs/Kconfigs/board/Kconfig

source configs/Kconfigs/toolchain/Kconfig

source configs/Kconfigs/busybox/Kconfig

source configs/Kconfigs/kernel/Kconfig

source configs/Kconfigs/image/Kconfig

source configs/Kconfigs/mmap/Kconfig

source configs/Kconfigs/sensor/Kconfig

source configs/Kconfigs/customer_options/Kconfig

source configs/Kconfigs/misc_options/Kconfig

source configs/Kconfigs/rtos/Kconfig

source configs/Kconfigs/sdk/Kconfig
```

## project/configs/Kconfigs/board/Kconfig
```kconfig
menu "Board"
config BOARD
    string "Board"
    default ""

config BOARD_NAME
    string "Board Name"
    default ""

endmenu
```

## project/configs/Kconfigs/chip/Kconfig
```kconfig
choice
    prompt "Chip"
    default I6E

    config I2M
        bool "i2m"

    config I6
        bool "i6"

    config I6E
        bool "i6e"

    config I6B0
        bool "i6b0"

    config M6
        bool "m6"

    config P3
        bool "p3"
endchoice

config CHIP
    string
    default i2m if I2M
    default i6 if I6
    default i6e if I6E
    default i6b0 if I6B0
    default m6 if M6
    default p3 if P3
    default i6e
```

## project/configs/Kconfigs/customer_options/Kconfig
```kconfig
menu "Customer Options"
config mi_dbg
    bool "Mi Dbg"
    default y

config MI_DBG
    int
    range 0 1
    default 0 if !mi_dbg
    default 1


config support_smart_display_vdec
    bool "Smart Display Vdec"
    default n

config SUPPORT_SMART_DISPLAY_VDEC
    int
    range 0 1
    default 0 if !support_smart_display_vdec
    default 1


config support_msos_mpool_add_pa2varange
    bool "MsOS MPool Add PA2VARange"
    default y

config SUPPORT_MsOS_MPool_Add_PA2VARange
    int
    range 0 1
    default 0 if !support_msos_mpool_add_pa2varange
    default 1


config support_disp_align_up_offset32
    bool "Disp Align Up Offset32"
    default y

config SUPPORT_DISP_ALIGN_UP_OFFSET32
    int
    range 0 1
    default 0 if !support_disp_align_up_offset32
    default 1


config support_hdmi_vga_direct_mode
    bool "HDMI VGA Direct Mode"
    default n

config SUPPORT_HDMI_VGA_DIRECT_MODE
    int
    range 0 1
    default 0 if !support_hdmi_vga_direct_mode
    default 1


config support_divp_use_ge_scaling_up
    bool "Divp Use GE Scaling Up"
    default n

config SUPPORT_DIVP_USE_GE_SCALING_UP
    int
    range 0 1
    default 0 if !support_divp_use_ge_scaling_up
    default 1


config support_vif_use_ge_fill_buf
    bool "Vif Use GE Fill Buf"
    default n

config SUPPORT_VIF_USE_GE_FILL_BUF
    int
    range 0 1
    default 0 if !support_vif_use_ge_fill_buf
    default 1


config support_stub_device_for_test_sys
    bool "Stub Device For Test Sys"
    default y

config SUPPORT_STUB_DEVICE_FOR_TEST_SYS
    int
    range 0 1
    default 0 if !support_stub_device_for_test_sys
    default 1


config support_vdec_multi_res
    bool "Vdec Multi Res"
    default n

config SUPPORT_VDEC_MULTI_RES
    int
    range 0 1
    default 0 if !support_vdec_multi_res
    default 1


config support_divp_p2_mode
    bool "Divp P2 Mode"
    default n

config SUPPORT_DIVP_P2_MODE
    int
    range 0 1
    default 0 if !support_divp_p2_mode
    default 1

config fb_video
    bool "Fb Video"
    default n

config FB_VIDEO
    int
    range 0 1
    default 0 if !fb_video
    default 1


menu "Mi Sys Pool Config"
config config_mi_enable_vb_pool
    bool "Mi Enable Vb Pool"
    default n

config CONFIG_MI_ENABLE_VB_POOL
    int
    range 0 1
    default 0 if !config_mi_enable_vp_pool
    default 1


config config_mi_enable_meta_pool
    bool "Mi Enable Meta Pool"
    default y

config CONFIG_MI_ENABLE_META_POOL
    int
    range 0 1
    default 0 if !config_mi_enable_meta_pool
    default 1


config config_mi_enable_sys_cfg
    bool "Mi Enable Sys Cfg"
    default y

config CONFIG_MI_ENABLE_SYS_CFG
    int
    range 0 1
    default 0 if !config_mi_enable_sys_cfg
    default 1


config config_mi_enable_shrinkable_pool
    bool "Mi Enable Shrinkable Pool"
    default n

config CONFIG_MI_ENABLE_SHRINKABLE_POOL
    int
    range 0 1
    default 0 if !config_mi_enable_shrinkable_pool
    default 1


config config_mi_enable_ringheap_pool
    bool "Mi Enable Ringheap Pool"
    default n

config CONFIG_MI_ENABLE_RINGHEAP_POOL
    int
    range 0 1
    default 0 if !config_mi_enable_ringheap_pool
    default 1
endmenu
config is_demo_board
    bool "is demo board"
    default n

config IS_DEMO_BOARD
    int "IS_DEMO_BOARD"
    range 0 3
    default 0 if !is_demo_board
    default 1
menu "Mi Venc Support"
config config_mi_venc_enable_jpeg
    bool "Mi Venc Enable Jpeg"
    default y

config CONFIG_MI_VENC_ENABLE_JPEG
    int
    range 0 1
    default 0 if !config_mi_venc_enable_jpeg
    default 1


config config_mi_venc_enable_h26x
    bool "Mi Venc Enable H26x"
    default y

config CONFIG_MI_VENC_ENABLE_H26X
    int
    range 0 1
    default 0 if !config_mi_venc_enable_h26x
    default 1

endmenu

endmenu
```

## project/configs/Kconfigs/image/Kconfig
```kconfig
menu "Image"

config IMAGE_CONFIG
    string "Image Partition Config"
    default "spinand.squashfs.partition.config"

choice
    prompt "Flash Size"
    default FLASE_SIZE_NONE

    config FLASH_SIZE_NONE
        bool "None"

    config FLASH_SIZE_8M
        bool "8M"

    config FLASH_SIZE_16M
        bool "16M"

    config FLASH_SIZE_32M
        bool "32M"
endchoice

config FLASH_SIZE
    string
    default "" if FLASH_SIZE_NONE
    default 8M if FLASH_SIZE_8M
    default 16M if FLASH_SIZE_16M
    default 32M if FLASH_SIZE_32M

config EMMC_BOOT_LINUX
    bool "eMMC boot linux"
    default "false"
    ---help---
        eMMC boot linux and nor/spinand boot onebin

config ONEBIN_BOOT_FLASH_TYPE
    string "boot.bin burn in which flash(nor/spinand) when emmc boot"
    depends on EMMC_BOOT_LINUX
    default ""
    ---help---
	if the flag is not "nor", it's "nand"

config EMMC_UPGRADE_PARTITION_SIZE
    hex "eMMC upgrade partition size(byte) when linux boot from eMMC"
    depends on EMMC_BOOT_LINUX
    default "0x00000"
    ---help---
	set eMMC upgrade partition size(byte), default is 0, means don't enable this function
	note: need to larger than the images_package's size

endmenu
```

## project/configs/Kconfigs/kernel/Kconfig
```kconfig
menu "Kernel"

choice
    prompt "Kernel Version"
    default KERNEL_VERSION_4.9.84

    config KERNEL_VERSION_4.9.84
        bool "4.9.84"

    config KERNEL_VERSION_4.9.227
        bool "4.9.227"
endchoice

config KERNEL_VERSION
    string
    default 4.9.84 if KERNEL_VERSION_4.9.84
    default 4.9.227 if KERNEL_VERSION_4.9.227


config KERNEL_CONFIG
    string "Kernel Config"
    default ""

config KERNEL_BOOT_ENV
    string "Kernel Boot Env"
    default ""

config EXBOOTARGS
    string "ExBootArgs"
    default ""

endmenu
```

## project/configs/Kconfigs/misc_options/Kconfig
```kconfig
menu "Misc Options"

config BOOL_FPGA
    bool "Fpga"
    default n

config FPGA
    int
    range 0 1
    default 1 if BOOL_FPGA
    default 0

config BOOL_BENCH
    bool "Bench"
    default n

config BENCH
    string
    default yes if BOOL_BENCH
    default no

config MHAL
    string "Mhal"
    default ""

config MERGE_BOOT
    string "Merge Boot"
    default ""

config BOOTLOGO_FILE
    string "Bootlogo File"
    default ""

config LOGO_ADDR
    string "Logo Addr"
    default ""

config BOOTLOGO_BUFSIZE
    string "Bootlogo Bufsize"
    default ""

config UPGRADE_FILE
    string "Upgrade File"
    default ""

config DISP_OUT_NAME
    string "Disp Out Name"
    default ""

config FBDEV
    string "Fbdev"
    default ""

config WIFI_MODULE
    string "Wifi Module"
    default ""

config SPEECH_VENDOR
    string "Speech Vendor"
    default ""

config ALINK
    string "Alink"
    default ""

endmenu
```

## project/configs/Kconfigs/product/Kconfig
```kconfig
choice
    prompt "Product"
    default IPC

    config IPC
        bool "ipc"

    config NVR
        bool "nvr"

    config XVR
        bool "xvr"

    config CARDV
        bool "cardv"

    config USBCAM
        bool "usbcam"

    config DISPCAM
        bool "dispcam"

    config DISPCAM-FASTBOOT
        bool "dispcam-fastboot"
    config DISP
        bool "disp"

    config DISP-FASTBOOT
        bool "disp-fastboot"

    config IPC-RTOS
        bool "ipc-rtos"

    config IPC-RTOS-SMPLH
        bool "ipc-rtos-smplh"

    config USBCAM-RTOS
        bool "usbcam-rtos"

    config IPC-FASTBOOT
        bool "ipc-fastboot"

    config NVR-FASTBOOT
        bool "nvr-fastboot"

    config USBCAM-FASTBOOT
        bool "usbcam-fastboot"

endchoice

config PRODUCT
    string
    default ipc if IPC
    default nvr if NVR
    default xvr if XVR
    default cardv if CARDV
    default usbcam if USBCAM
    default dispcam if DISPCAM
    default dispcam-fastboot if DISPCAM-FASTBOOT
    default disp if DISP
    default disp-fastboot if DISP-FASTBOOT
    default ipc-rtos if IPC-RTOS
    default ipc-rtos-smplh if IPC-RTOS-SMPLH
    default usbcam-rtos if USBCAM-RTOS
    default ipc-fastboot if IPC-FASTBOOT
    default nvr-fastboot if NVR-FASTBOOT
    default usbcam-fastboot if USBCAM-FASTBOOT
    default ipc
```

## project/configs/Kconfigs/rtos/Kconfig
```kconfig
menu "Rtos"

config BOOL_DUAL_OS
    bool "Dual Os"
    default n

config DUAL_OS
    string
    default "on" if BOOL_DUAL_OS
    default "off"

config BOOL_FAST_DEMO
    bool "Fast Demo"
    default n

config FAST_DEMO
    string
    default "on" if BOOL_FAST_DEMO
    default "off"

config SENSOR_TYPE0
    string "Sensor Type 0"
    default ""

config SENSOR_TYPE1
    string "Sensor Type 1"
    default ""

config LINUX_MEM_SIZE
    string "Linux Mem Size"
    default ""


config RTOS_BIN
    string "Rtos Bin"
    default ""

config RTOS_LOAD_ADDR
    string "Rtos Load Addr"
    default ""


config MMA_BASE
    string "Mma Base"
    default ""

config MMA_SIZE
    string "Mma Size"
    default ""

endmenu
```

## project/configs/Kconfigs/sdk/Kconfig
```kconfig
menu "Sdk Config"
source configs/Kconfigs/sdk/verify/Kconfig

source configs/Kconfigs/sdk/interface/Kconfig

source configs/Kconfigs/sdk/misc/Kconfig

source configs/Kconfigs/sdk/mhal/Kconfig

endmenu
```
